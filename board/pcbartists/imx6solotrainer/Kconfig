## board/pcbartists/imx6solotrainer/Kconfig
```kconfig
if TARGET_IMX6SOLOTRAINER

config SYS_BOARD
	default "imx6solotrainer"

config SYS_VENDOR
	default "pcbartists"

config SYS_CONFIG_NAME
	default "imx6solotrainer"

endif
```

## configs/imx6solotrainer_defconfig
```kconfig
CONFIG_ARM=y
CONFIG_ARCH_MX6=y
CONFIG_TARGET_IMX6SOLOTRAINER=y
CONFIG_MXC_UART=y
```
